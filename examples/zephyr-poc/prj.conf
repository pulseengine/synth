## CMakeLists.txt
```
# Synth WASM Compiler - Zephyr POC
#
# Demonstrates WASM function compiled to ARM and linked with Zephyr

cmake_minimum_required(VERSION 3.20.0)

find_package(Zephyr REQUIRED HINTS $ENV{ZEPHYR_BASE})
project(synth_wasm_poc)

# Main application
target_sources(app PRIVATE src/main.c)

# Link with Synth-compiled WASM function
target_sources(app PRIVATE src/add.s)
```

## prj.conf
```kconfig
# Synth WASM POC - Zephyr Configuration

# Enable console for output
CONFIG_PRINTK=y
CONFIG_CONSOLE=y
```

## src/main.c
```c
/*
 * Synth WASM POC for Zephyr
 *
 * Demonstrates calling WASM-compiled function from Zephyr
 */

#include <zephyr/kernel.h>
#include <zephyr/sys/printk.h>

/* Declare WASM function compiled by Synth */
extern int32_t synth_add(int32_t a, int32_t b);

int main(void)
{
	int32_t counter = 0;
	int32_t result;

	printk("\n");
	printk("===========================================\n");
	printk("  Synth WASM Compiler - Zephyr POC\n");
	printk("===========================================\n");
	printk("\n");
	printk("Calling WASM function every 100ms...\n");
	printk("\n");

	while (1) {
		/* Call the WASM-compiled function */
		result = synth_add(counter, 42);

		printk("[%6d ms] synth_add(%d, 42) = %d\n",
		       k_uptime_get_32(), counter, result);

		counter++;

		/* Sleep 100ms */
		k_msleep(100);
	}

	return 0;
}
```
