@ Anti-Pinch Window Controller -- ARM Thumb-2 Assembly
@ Generated by Synth WASM Compiler (manually written reference)
@ Target: ARM Cortex-M4 (Thumb-2)
@
@ Register conventions:
@   R0-R3   : parameters / return / scratch
@   R4-R7   : callee-saved temporaries
@   R9      : WASM globals base (reserved)
@   R10     : WASM memory size (reserved)
@   R11     : WASM linear memory base (reserved)
@   R12     : scratch
@   R13 (SP): stack pointer
@   R14 (LR): link register
@   R15 (PC): program counter
@
@ Memory layout (offsets from R11):
@   [R11+0]  window_position     (0-1000)
@   [R11+4]  motor_current_ma    (milliamps)
@   [R11+8]  pwm_duty            (0-1000)
@   [R11+12] direction           (0=stopped, 1=closing, 2=opening)
@   [R11+16] jam_detected        (0/1)
@   [R11+20] current_threshold_ma
@   [R11+24] target_position     (0-1000)
@   [R11+28] pwm_ramp_rate
@   [R11+32] consecutive_over
@   [R11+36] jam_debounce_limit

.syntax unified
.thumb
.text

@ ==========================================================================
@ init -- Initialize controller state to safe defaults
@ WASM signature: (func (export "init"))
@ ==========================================================================
.global synth_init
.type synth_init, %function
synth_init:
    push {r4-r7, lr}

    @ Clear all state to zero first
    mov r0, #0
    str r0, [r11, #0]       @ window_position = 0
    str r0, [r11, #4]       @ motor_current_ma = 0
    str r0, [r11, #8]       @ pwm_duty = 0
    str r0, [r11, #12]      @ direction = 0 (stopped)
    str r0, [r11, #16]      @ jam_detected = 0
    str r0, [r11, #24]      @ target_position = 0
    str r0, [r11, #32]      @ consecutive_over = 0

    @ Set non-zero defaults
    mov r0, #800
    str r0, [r11, #20]      @ current_threshold_ma = 800

    mov r0, #20
    str r0, [r11, #28]      @ pwm_ramp_rate = 20 (2.0%/tick)

    mov r0, #3
    str r0, [r11, #36]      @ jam_debounce_limit = 3

    pop {r4-r7, pc}
.size synth_init, .-synth_init


@ ==========================================================================
@ set_target -- Set desired window position, clamp to [0, 1000]
@ WASM signature: (func (export "set_target") (param i32))
@ R0 = target position
@ ==========================================================================
.global synth_set_target
.type synth_set_target, %function
synth_set_target:
    push {r4-r7, lr}

    @ Clamp R0 to [0, 1000]
    cmp r0, #0
    bge .Lst_not_neg
    mov r0, #0
.Lst_not_neg:
    mov r4, #1000
    cmp r0, r4
    ble .Lst_not_over
    mov r0, r4
.Lst_not_over:
    @ Store target
    str r0, [r11, #24]

    @ Clear jam flag (allow retry)
    mov r0, #0
    str r0, [r11, #16]

    @ Reset debounce counter
    str r0, [r11, #32]

    pop {r4-r7, pc}
.size synth_set_target, .-synth_set_target


@ ==========================================================================
@ update_current -- Feed motor current sensor reading
@ WASM signature: (func (export "update_current") (param i32))
@ R0 = current in milliamps
@ ==========================================================================
.global synth_update_current
.type synth_update_current, %function
synth_update_current:
    push {r4, lr}
    str r0, [r11, #4]       @ motor_current_ma = R0
    pop {r4, pc}
.size synth_update_current, .-synth_update_current


@ ==========================================================================
@ check_jam -- Check if current exceeds threshold
@ WASM signature: (func (export "check_jam") (param i32 i32) (result i32))
@ R0 = current_ma, R1 = threshold_ma
@ Returns: 1 if jam, 0 otherwise
@ ==========================================================================
.global synth_check_jam
.type synth_check_jam, %function
synth_check_jam:
    push {r4, lr}
    cmp r0, r1
    bgt .Lcj_jam
    mov r0, #0
    b .Lcj_done
.Lcj_jam:
    mov r0, #1
.Lcj_done:
    pop {r4, pc}
.size synth_check_jam, .-synth_check_jam


@ ==========================================================================
@ ramp_pwm -- Soft start/stop: ramp current toward target by ramp_rate
@ WASM signature: (func (export "ramp_pwm") (param i32 i32) (result i32))
@ R0 = current_pwm, R1 = target_pwm
@ Returns: new PWM value after one ramp step
@ ==========================================================================
.global synth_ramp_pwm
.type synth_ramp_pwm, %function
synth_ramp_pwm:
    push {r4-r7, lr}

    @ R4 = ramp_rate from memory
    ldr r4, [r11, #28]

    @ R5 = diff = target - current
    subs r5, r1, r0

    @ If diff > ramp_rate: step up
    cmp r5, r4
    ble .Lrp_check_down
    add r0, r0, r4          @ result = current + ramp_rate
    b .Lrp_clamp

.Lrp_check_down:
    @ If diff < -ramp_rate: step down
    rsb r6, r4, #0          @ r6 = -ramp_rate
    cmp r5, r6
    bge .Lrp_snap
    sub r0, r0, r4          @ result = current - ramp_rate
    b .Lrp_clamp

.Lrp_snap:
    @ Close enough: snap to target
    mov r0, r1

.Lrp_clamp:
    @ Clamp result to [0, 1000]
    cmp r0, #0
    bge .Lrp_clamp_hi
    mov r0, #0
.Lrp_clamp_hi:
    mov r6, #1000
    cmp r0, r6
    ble .Lrp_done
    mov r0, r6
.Lrp_done:
    pop {r4-r7, pc}
.size synth_ramp_pwm, .-synth_ramp_pwm


@ ==========================================================================
@ tick -- Main control cycle (100Hz)
@ WASM signature: (func (export "tick") (result i32))
@ Returns: PWM duty cycle (0-1000)
@
@ This is the safety-critical function:
@   1. Check if jam already flagged -> return 0
@   2. Determine direction from position vs target
@   3. If closing AND current over threshold (debounced) -> JAM STOP
@   4. Ramp PWM toward target duty
@   5. Update position estimate
@   6. If position reached target -> stop
@   7. Return PWM
@ ==========================================================================
.global synth_tick
.type synth_tick, %function
synth_tick:
    push {r4-r7, lr}

    @ Load state into registers
    @ R4 = position, R5 = target, R6 = current_ma, R7 = threshold
    ldr r4, [r11, #0]       @ position
    ldr r5, [r11, #24]      @ target
    ldr r6, [r11, #4]       @ motor_current_ma
    ldr r7, [r11, #20]      @ current_threshold_ma

    @ ---- Check if jam already flagged ----
    ldr r0, [r11, #16]
    cmp r0, #1
    bne .Ltk_no_prev_jam
    @ Jam flagged: force stop
    mov r0, #0
    str r0, [r11, #8]       @ pwm = 0
    str r0, [r11, #12]      @ direction = stopped
    mov r0, #0
    pop {r4-r7, pc}

.Ltk_no_prev_jam:
    @ ---- Determine direction ----
    @ R0 = direction, R1 = target_pwm
    cmp r5, r4
    bgt .Ltk_closing
    blt .Ltk_opening

    @ target == position: stop
    mov r0, #0               @ direction = stopped
    mov r1, #0               @ target_pwm = 0
    b .Ltk_dir_done

.Ltk_closing:
    mov r0, #1               @ direction = closing
    mov r1, #800             @ target_pwm = 800 (80%)
    b .Ltk_dir_done

.Ltk_opening:
    mov r0, #2               @ direction = opening
    mov r1, #800             @ target_pwm = 800 (80%)

.Ltk_dir_done:
    @ Store direction
    str r0, [r11, #12]

    @ Save direction in R2, target_pwm in R3 for later
    mov r2, r0
    mov r3, r1

    @ ---- JAM DETECTION (only while closing, direction==1) ----
    cmp r2, #1
    bne .Ltk_no_jam_check

    @ Check current > threshold
    cmp r6, r7
    ble .Ltk_current_ok

    @ Over threshold: increment consecutive counter
    ldr r0, [r11, #32]      @ consecutive_over
    add r0, r0, #1
    str r0, [r11, #32]

    @ Check debounce limit
    ldr r1, [r11, #36]      @ jam_debounce_limit
    cmp r0, r1
    blt .Ltk_ramp           @ Not yet confirmed

    @ JAM CONFIRMED: emergency stop
    mov r0, #1
    str r0, [r11, #16]      @ jam_detected = 1
    mov r0, #0
    str r0, [r11, #8]       @ pwm = 0
    str r0, [r11, #12]      @ direction = stopped
    str r0, [r11, #32]      @ reset debounce counter
    mov r0, #0
    pop {r4-r7, pc}

.Ltk_current_ok:
    @ Current below threshold: reset debounce counter
    mov r0, #0
    str r0, [r11, #32]

.Ltk_no_jam_check:

.Ltk_ramp:
    @ ---- PWM RAMPING ----
    @ R0 = current PWM, R1 = target PWM
    ldr r0, [r11, #8]       @ current pwm
    mov r1, r3              @ target_pwm (saved earlier)

    @ Inline ramp logic
    ldr r6, [r11, #28]      @ ramp_rate (reuse R6, current_ma no longer needed)
    subs r7, r1, r0         @ diff = target - current (reuse R7)

    cmp r7, r6
    ble .Ltk_ramp_check_down
    add r0, r0, r6          @ step up by ramp_rate
    b .Ltk_ramp_clamp

.Ltk_ramp_check_down:
    rsb r1, r6, #0          @ -ramp_rate (we can clobber R1 now)
    cmp r7, r1
    bge .Ltk_ramp_snap
    sub r0, r0, r6          @ step down by ramp_rate
    b .Ltk_ramp_clamp

.Ltk_ramp_snap:
    mov r0, r3              @ snap to target_pwm

.Ltk_ramp_clamp:
    @ Clamp to [0, 1000]
    cmp r0, #0
    bge .Ltk_ramp_hi
    mov r0, #0
.Ltk_ramp_hi:
    mov r1, #1000
    cmp r0, r1
    ble .Ltk_ramp_store
    mov r0, r1
.Ltk_ramp_store:
    @ R0 = new_pwm, store it
    str r0, [r11, #8]

    @ ---- POSITION UPDATE ----
    @ position_delta = new_pwm / 100
    mov r1, #100
    sdiv r6, r0, r1         @ R6 = position_delta

    @ R2 = direction (still valid from earlier)
    cmp r2, #1
    bne .Ltk_check_open

    @ Closing: position += delta
    add r4, r4, r6
    @ Clamp: don't overshoot target
    cmp r4, r5
    ble .Ltk_pos_store
    mov r4, r5
    b .Ltk_pos_store

.Ltk_check_open:
    cmp r2, #2
    bne .Ltk_pos_store

    @ Opening: position -= delta
    sub r4, r4, r6
    @ Clamp: don't undershoot target
    cmp r4, r5
    bge .Ltk_pos_store
    mov r4, r5

.Ltk_pos_store:
    str r4, [r11, #0]       @ Store updated position

    @ ---- Check if reached target ----
    cmp r4, r5
    bne .Ltk_return_pwm

    @ Reached target: stop motor
    mov r1, #0
    str r1, [r11, #12]      @ direction = stopped
    str r1, [r11, #8]       @ pwm = 0
    mov r0, #0
    pop {r4-r7, pc}

.Ltk_return_pwm:
    @ R0 still holds new_pwm from ramp
    pop {r4-r7, pc}
.size synth_tick, .-synth_tick


@ ==========================================================================
@ get_position -- Read current window position
@ WASM signature: (func (export "get_position") (result i32))
@ ==========================================================================
.global synth_get_position
.type synth_get_position, %function
synth_get_position:
    push {r4, lr}
    ldr r0, [r11, #0]
    pop {r4, pc}
.size synth_get_position, .-synth_get_position


@ ==========================================================================
@ get_pwm -- Read current PWM duty cycle
@ WASM signature: (func (export "get_pwm") (result i32))
@ ==========================================================================
.global synth_get_pwm
.type synth_get_pwm, %function
synth_get_pwm:
    push {r4, lr}
    ldr r0, [r11, #8]
    pop {r4, pc}
.size synth_get_pwm, .-synth_get_pwm


@ ==========================================================================
@ get_direction -- Read motor direction (0=stop, 1=closing, 2=opening)
@ WASM signature: (func (export "get_direction") (result i32))
@ ==========================================================================
.global synth_get_direction
.type synth_get_direction, %function
synth_get_direction:
    push {r4, lr}
    ldr r0, [r11, #12]
    pop {r4, pc}
.size synth_get_direction, .-synth_get_direction


@ ==========================================================================
@ is_jam_detected -- Read jam flag
@ WASM signature: (func (export "is_jam_detected") (result i32))
@ ==========================================================================
.global synth_is_jam_detected
.type synth_is_jam_detected, %function
synth_is_jam_detected:
    push {r4, lr}
    ldr r0, [r11, #16]
    pop {r4, pc}
.size synth_is_jam_detected, .-synth_is_jam_detected


@ ==========================================================================
@ clear_jam -- Reset jam flag for retry
@ WASM signature: (func (export "clear_jam"))
@ ==========================================================================
.global synth_clear_jam
.type synth_clear_jam, %function
synth_clear_jam:
    push {r4, lr}
    mov r0, #0
    str r0, [r11, #16]      @ jam_detected = 0
    str r0, [r11, #32]      @ consecutive_over = 0
    pop {r4, pc}
.size synth_clear_jam, .-synth_clear_jam
